## clawd_mood_idf/sdkconfig.defaults
```kconfig
# Flash 4MB（板子常见容量；若实际不同，build 后在 menuconfig 调整）
CONFIG_ESPTOOLPY_FLASHSIZE_4MB=y
CONFIG_ESPTOOLPY_FLASHSIZE="4MB"

# 编译优化为体积优先，给后续大固件留空间
CONFIG_COMPILER_OPTIMIZATION_SIZE=y

# 自定义分区表：单 factory 1.75MB，容 WiFi+HTTP+配网页（旧 1MB 默认分区不够）
CONFIG_PARTITION_TABLE_CUSTOM=y
CONFIG_PARTITION_TABLE_CUSTOM_FILENAME="partitions.csv"
```
